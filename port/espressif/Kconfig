## port/espressif/Kconfig
```kconfig
menu "cellular"

config PIN_CELLULAR_ENABLE_POWER
    int "the ESP32 GPIO output pin that enables power to the cellular module"
    default 2
    help
        Set this to configure the power enable output pin to the cellular module. Note that this is the
        GPIO pin number of the ESP32 chip, NOT the pin number of a NINA-W1 module, they are entirely
        different, see table 5 of the NINA-W1 data sheet for a conversion table.

config PIN_CELLULAR_CP_ON
    int "the ESP32 GPIO output pin that is connected to the CP_ON pin of the cellular module"
    default 25
    help
        Set this to configure the pin of the ESP32 chip that is connected to the CP_ON pin of the
        cellular module. Note that this is the GPIO pin number of the ESP32 chip, NOT the pin number of
        a NINA-W1 module, they are entirely different, see table 5 of the NINA-W1 data sheet for a
        conversion table. The default value of 25 is pin 16 of the NINA-W1 module and is accessible
        on J14 pin 11 of EVK-NINA-W1.

config PIN_CELLULAR_VINT
    int "the ESP32 GPIO input pin that is connected to the VInt pin of the cellular module"
    default 36
    help
        Set this to configure the pin of the ESP32 chip that is connected to the VInt pin of the
        cellular module. Note that this is the GPIO pin number of the ESP32 chip, NOT the pin number
        of a NINA-W1 module, they are entirely different, see table 5 of the NINA-W1 data sheet for
        a conversion table.

config UART
    int "the ESP32 UART HW block to use"
    default 1
    help
        Set this to configure the HW block of the ESP32 chip that is to be used. HW block 0 is usually
        used for stdio and HW block 1 for the cellular UART.

config PIN_TXD
    int "the ESP32 GPIO output pin that sends UART data to the cellular module"
    default 4
    help
        Set this to configure the TXD (output) pin to the cellular module. Note that this is the
        GPIO pin number of the ESP32 chip, NOT the pin number of a NINA-W1 module, they are entirely
        different, see table 5 of the NINA-W1 data sheet for a conversion table.

config PIN_RXD
    int "the ESP32 GPIO input pin that receives UART data from the cellular module"
    default 15
    help
        Set this to configure the RXD (input) pin receiving UART data from the cellular module. Note
        that this is the GPIO pin number of the ESP32 chip, NOT the pin number of a NINA-W1 module,
        they are entirely different, see table 5 of the NINA-W1 data sheet for a conversion table.

config BAUD_RATE
    int "the baud rate to use on the UART interface to the cellular module"
    default 115200
    help
        Set this to configure the baud rate on the UART interface to the cellular module.

config PIN_CTS
    int "the ESP32 GPIO input pin that the cellular modem will use to indicate that it can send data"
    default -1
    help
        Set this to configure the CTS (input) pin from the cellular module. Note that this
        is the GPIO pin number of the ESP32 chip, NOT the pin number of a NINA-W1 module,
        they are entirely different, see table 5 of the NINA-W1 data sheet for a conversion
        table.

config PIN_RTS
    int "the ESP32 GPIO output pin that tells the cellular modem that it can send more data to us"
    default -1
    help
        Set this to configure the RTS (output) pin to the cellular module Note that this
        is the GPIO pin number of the ESP32 chip, NOT the pin number of a NINA-W1 module,
        they are entirely different, see table 5 of the NINA-W1 data sheet for a conversion
        table.

config RTS_THRESHOLD
    int "the buffer threshold at which RTS is de-asserted, indicating the cellular module should stop sending data to us"
    default 0
    help
        Set this to configure the buffer length at which the UART will stop the cellular module
        from sending more data to us (by de-asserting RTS).

endmenu
```
